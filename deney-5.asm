	LIST P=16F877A
	#INCLUDE <P16F877A.INC>
	__CONFIG H'3F31'
	SAYICI1 EQU 0X20
	SAYICI2 EQU 0X21
	ORG 0X000
	GOTO ANA_METOT

ANA_METOT
	BANKSEL TRISA
	MOVLW 0X06
	MOVWF ADCON1
	MOVLW 0XFF
	MOVWF TRISA
	CLRF TRISC
	BANKSEL PORTA
	MOVLW 0XFF
	MOVWF PORTA
	CLRF PORTC

	BANKSEL CCP1CON
	MOVLW B'00001100'
	MOVWF CCP1CON
	BANKSEL CCP1CON
	
	BANKSEL CCP2CON
	MOVLW B'00001100'
	MOVWF CCP2CON
	BANKSEL CCP2CON

	BANKSEL T2CON
	MOVLW B'00000110'
	MOVWF T2CON
	BANKSEL T2CON

	BANKSEL PR2
	MOVLW D'49'
	MOVWF PR2

	BANKSEL CCPR1L
	CLRF CCPR1L
	
	BANKSEL CCPR2L
	CLRF CCPR2L

KONTROL
	BTFSC PORTA,2
	GOTO ARTMA_METOT
	BTFSC PORTA,3
	GOTO AZALTMA_METOT
	GOTO KONTROL

ARTMA_METOT
	CALL GECIKME
	MOVLW D'100'
	SUBWF CCPR1L,W		;CCPR1L-100
	BTFSC STATUS,Z
	GOTO KONTROL
	CALL DEGER_ARTIR_1

	MOVLW D'100'
	SUBWF CCPR2L,W
	BTFSC STATUS,Z
	GOTO KONTROL
	CALL DEGER_ARTIR_2

	GOTO KONTROL

DEGER_ARTIR_1
	MOVLW D'5'
	ADDWF CCPR1L,F
	RETURN

DEGER_ARTIR_2
	MOVLW D'5'
	ADDWF CCPR2L,F
	RETURN

AZALTMA_METOT
	CALL GECIKME
	MOVLW D'0'
	SUBWF CCPR1L,W
	BTFSC STATUS,Z
	GOTO KONTROL
	MOVLW D'5'
	SUBWF CCPR1L,F

	MOVLW D'0'
	SUBWF CCPR2L,W
	BTFSC STATUS,Z
	GOTO KONTROL
	MOVLW D'5'
	SUBWF CCPR2L,F
	GOTO KONTROL

GECIKME
	MOVLW 0XFF
	MOVWF SAYICI1

TEKRAR1
	MOVLW 0XFF
	MOVWF SAYICI2 

TEKRAR2
	DECFSZ SAYICI2,F
	GOTO TEKRAR2
	DECFSZ SAYICI1,F
	GOTO TEKRAR1
	RETURN

END